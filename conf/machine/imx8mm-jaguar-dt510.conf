## conf/machine/imx8mm-jaguar-dt510.conf
```bitbake
#@TYPE: Machine
#@NAME: Dynamic Devices i.MX 8M Mini Jaguar DT510 board with LPDDR4
#@SOC: i.MX8MM
#@DESCRIPTION: Machine configuration for Dynamic Devices i.MX 8M Mini Jaguar DT510 board with LPDDR4
#@MAINTAINER: Alex J Lennon  <ajlennon@dynamicdevices.co.uk>

MACHINEOVERRIDES =. "imx8mm-lpddr4-evk:"

require conf/machine/imx8mm-lpddr4-evk.conf
require conf/machine/include/tas2562.inc
require conf/machine/include/tas2563.inc
require conf/machine/include/ksz9896.inc
require conf/machine/include/cp2108-usb-serial.inc
require conf/machine/include/mcp251xfd-can.inc

KMACHINE = "imx8mmevk"
# mlan then moal — same order as imx93-jaguar-eink / NXP MOAL README for IW612 SDIO
KERNEL_MODULE_AUTOLOAD:imx8mm-jaguar-dt510 = " i2c-dev spidev snd-aloop mlan moal"

MACHINE_FEATURES:remove:imx8mm-jaguar-dt510 = " nxp8987-sdio"

# Need to remove nxpiw612 to build SDK as for some reason it errors with a conflict with linux-firmware
# TODO: DT510 will use ublox MAYA-W2 WiFi module (IW612 chipset) - same as eink board
# For now using sentai WiFi configuration for demo purposes only - will be updated when new hardware arrives
# STUSB4500 / USB-C PD: not populated on DT510 (hardware; Sentai carries STUSB4500).
# tas6424: Tier C2 class-D on SAI1 — kernel SND_SOC_TAS6424 (see linux-lmp-fslc-imx bbappend)
# bq25792-charger: bq25792-charger.cfg + kernel patches 0010-mfd-bq257xx-*.patch + bq257xx-mfd-kconfig.cfg.
# To disable: MACHINE_FEATURES:remove:imx8mm-jaguar-dt510 = " bq25792-charger"
# cp2108-usb-serial: CONFIG_USB_SERIAL_CP210X — see cp2108-usb-serial.inc.
# To disable: MACHINE_FEATURES:remove:imx8mm-jaguar-dt510 = " cp2108-usb-serial"
# mcp251xfd-can: SocketCAN MCP251xFD — see mcp251xfd-can.inc.
# To disable: MACHINE_FEATURES:remove:imx8mm-jaguar-dt510 = " mcp251xfd-can"
# ksz9896: KSZ9896 DSA switch — CONFIG fragments from imx8mm-jaguar-dt510/ksz9896-*.cfg (see ksz9896.inc).
# To disable: MACHINE_FEATURES:remove:imx8mm-jaguar-dt510 = " ksz9896"
# tas2563: TAS2563 smart amp — tas2562-audio-codec.cfg + tas2781/tas2563 patches + tas2562-driver.cfg (see tas2563.inc).
# To disable: MACHINE_FEATURES:remove:imx8mm-jaguar-dt510 = " tas2563"
MACHINE_FEATURES:append:imx8mm-jaguar-dt510 = " nxpiw612-sdio zigbee tas2563 tas6424 bq25792-charger ksz9896 cp2108-usb-serial mcp251xfd-can"

# USB dual UAC2 gadget (simulated / lab path): optional autostart of usb-dual-audio-gadget-dt510.service.
# Enable lab autostart with: MACHINE_FEATURES:append:imx8mm-jaguar-dt510 = " dt510-usb-dual-audio-autostart"
# Scripts stay installed; manual: systemctl start usb-dual-audio-gadget-dt510

#SKIP_RECIPE[linux-firmware] = "linux-firmware is blacklisted"

# NOTE: This is *not* used for the lmp DISTRO / CI. This is just included for local development with lmp-base
KERNEL_DEVICETREE:append:imx8mm-jaguar-dt510 = " imx8mm-jaguar-dt510.dtb"

# Fix imx-vpu-hantro build failure
TOOLCHAIN:pn-imx-vpu-hantro = "gcc"
TOOLCHAIN:pn-imx-vpu-hantro-daemon = "gcc"

# Fix nxp-afe* build failure
TOOLCHAIN:pn-nxp-afe = "gcc"
TOOLCHAIN:pn-nxp-afe-voiceseeker = "gcc"

# Need to have a larger SPI buffer for SPINEL protocol (Zigbee/OpenThread)
KERNEL_MODULE_PROBECONF:append:imx8mm-jaguar-dt510 = " spidev moal"
module_conf_spidev = "options spidev bufsiz=32768"
# MOAL loads IW612 firmware using paths in /lib/firmware/nxp/wifi_mod_para.conf (SDIW612 fw_name).
# Do NOT set fw_name here: firmware-nxp-wifi bbappend toggles .bin vs .bin.se via NXP_WIFI_INSECURE_FIRMWARE;
# a modprobe fw_name that disagrees with the file on disk causes request_firmware to fail even when mlan/moal load.
# For verbose firmware/download logs: drvdbg=2 (then set back to 0 for production).
module_conf_moal = "options moal drvdbg=0"

# Ship SDIO WiFi firmware blobs (IW612). Without this package the rootfs may lack nxp/*.bin[.se] and moal/mlan never attach.
MACHINE_EXTRA_RDEPENDS:append:imx8mm-jaguar-dt510 = " firmware-nxp-wifi-nxpiw612-sdio"
# dt510-router — NM WAN (lan1) + LAN bridge + DHCP/NAT on br-lan (lan2–lan4). Disabled until re-enabled for field testing.
# MACHINE_EXTRA_RDEPENDS:append:imx8mm-jaguar-dt510 = " dt510-router"

# USB Gadget support - disabled to prevent automatic startup
# MACHINE_EXTRA_RDEPENDS:append:imx8mm-jaguar-dt510 = " usb-composite-gadget"

# Secure boot SE050 into OpTee (disabled for local development builds)
MACHINE_FEATURES:append:imx8mm-jaguar-dt510 = "${@'' if d.getVar('LOCAL_DEVELOPMENT_BUILD') == '1' else ' se05x'}"
# TODO: This line doesn't appear to take effect so overriding it in the OpTee recipe for now
SE05X_OEFID:imx8mm-jaguar-dt510 = "0xA200"

SERIAL_CONSOLES = "115200:ttyUSBConsole"
```

## conf/machine/include/cp2108-usb-serial.inc
```bitbake
# Silicon Labs CP2108 USB UART bridge — kernel fragment `cp2108-usb-serial.cfg` from
# linux-lmp-fslc-imx_%.bbappend when MACHINE_FEATURES contains `cp2108-usb-serial`.

MACHINE_FEATURES_BACKFILL_CONSIDERED:append = " cp2108-usb-serial"
```

## conf/machine/include/ksz9896.inc
```bitbake
# Microchip KSZ9896 — DSA Ethernet switch (I2C management + built-in PHYs).
# Kernel fragments `ksz9896-ethernet-switch.cfg` + `ksz9896-mii-phy.cfg` are appended from
# linux-lmp-fslc-imx_%.bbappend when MACHINE_FEATURES contains `ksz9896`.

MACHINE_FEATURES_BACKFILL_CONSIDERED:append = " ksz9896"
```

## conf/machine/include/mcp251xfd-can.inc
```bitbake
# Microchip MCP251xFD CAN controller — kernel fragment `mcp251xfd-can.cfg` from
# linux-lmp-fslc-imx_%.bbappend when MACHINE_FEATURES contains `mcp251xfd-can`.

MACHINE_FEATURES_BACKFILL_CONSIDERED:append = " mcp251xfd-can"
```

## conf/machine/include/tas2562.inc
```bitbake
# TAS2562 Driver Configuration
# This configuration enables the mainline TAS2562 driver with native TAS2563 support
# Uses the original TAS2562 driver which is register-compatible with TAS2563

# Machine feature definition
MACHINE_FEATURES_BACKFILL_CONSIDERED:append = " tas2562"

# TAS2562 driver is built into kernel with native TAS2563 support
# Remove any conflicting TAS2781 drivers and modules
MACHINE_EXTRA_RRECOMMENDS:remove = " \
    ${@bb.utils.contains('MACHINE_FEATURES', 'tas2562', 'kernel-module-tas2781 kernel-module-tas2563', bb.utils.contains('MACHINE_FEATURES', 'tas2563', 'kernel-module-tas2781 kernel-module-tas2563', '', d), d)} \
"

# Add TAS2563 firmware for TAS2562 driver (if needed)
MACHINE_EXTRA_RRECOMMENDS:append = " \
    ${@bb.utils.contains('MACHINE_FEATURES', 'tas2562', 'firmware-tas2563', bb.utils.contains('MACHINE_FEATURES', 'tas2563', 'firmware-tas2563', '', d), d)} \
"

# Ensure proper module loading order
KERNEL_MODULE_PROBECONF:append = " \
    ${@bb.utils.contains('MACHINE_FEATURES', 'tas2562', 'snd-soc-tas2562', bb.utils.contains('MACHINE_FEATURES', 'tas2563', 'snd-soc-tas2562', '', d), d)} \
"

# Configure TAS2562 module for optimal TAS2563 operation
# GPIO polarity is handled via device tree GPIO_ACTIVE_HIGH/LOW flags
```

## conf/machine/include/tas2563.inc
```bitbake
# TI TAS2563 smart amplifier — kernel uses the TAS2562 ASoC stack + tas2781/tas2563 patches
# (`CONFIG_SND_SOC_TAS2562`, `ti,tas2563`). Fragments are gated from linux-lmp-fslc-imx_%.bbappend
# when MACHINE_FEATURES contains `tas2563`.
#
# To disable on a machine that includes this file: MACHINE_FEATURES:remove:<machine> = " tas2563"

MACHINE_FEATURES_BACKFILL_CONSIDERED:append = " tas2563"
```
